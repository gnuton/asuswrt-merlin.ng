// SPDX-License-Identifier: (GPL-2.0+ OR BSD-3-Clause)
/*
 * IPQ5332 AP-MI04.3 board device tree source
 *
 * Copyright (c) 2020 The Linux Foundation. All rights reserved.
 * Copyright (c) 2022-2023 Qualcomm Innovation Center, Inc. All rights reserved.
 */

#include <arm64/qcom/ipq5332-mi04.3.dts>

/ {
	chosen {
		stdout-path = "serial0";
		bootargs-append = " clk_ignore_unused vmalloc=1G";
	};
};
