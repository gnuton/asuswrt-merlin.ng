// SPDX-License-Identifier: (GPL-2.0+ OR BSD-3-Clause)
/*
 * IPQ9574 AL03-C2 board device tree source
 * Copyright (c) 2020-2021 The Linux Foundation. All rights reserved.
 * Copyright (c) 2022 Qualcomm Innovation Center, Inc. All rights reserved.
 */
#include <arm64/qcom/ipq9574-al03-c2.dts>

/ {
        chosen {
                stdout-path = "serial0";
                bootargs-append = " clk_ignore_unused vmalloc=1G";
        };
};
