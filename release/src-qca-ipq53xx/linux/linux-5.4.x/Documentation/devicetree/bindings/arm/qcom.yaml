## release/src-qca-ipq53xx/linux/linux-5.4.x/Documentation/devicetree/bindings/net/qcom-nss-cryptov2-ce5.txt
```
* Qualcomm Technologies Inc. NSS CRYPTO Driver.

This driver is responsible for setting up the ipq50xx crypto engine.
The driver is responsible for initialization of crypto engine, downloading
of crypto engine firmware, allocating a dma, setting up context record.

Required properties:
- compatible: "qcom,nss-crypto"
- qcom,max-contexts: Maximum number of supported context
- qcom,max-context-size: Maximum context size in words supported by HW.
- ranges: used when there is a reg_map in child node.

* ce5_node: This is the first child node that denotes that this driver supports ce5 crypto engine.

Required properties:
- compatible: "qcom,ce5".
- reg-names: Indicates various resources passed to driver by name.
- reg: physical address and length of the register set for the device.
- qcom,dma-mask: Max dma rings supported, each bit represent a ring number
- qcom,transform-enabled: Whether Packet for tranformation will be sent from host or not.
- qcom,aes128-cbc: Enable crypto algorithm
- qcom,aes256-cbc: Enable crypto algorithm
- qcom,aes128-ctr: Enable crypto algorithm
- qcom,aes256-ctr: Enable crypto algorithm
- qcom,aes128-ecb: Enable crypto algorithm
- qcom,aes256-ecb: Enable crypto algorithm
- qcom,3des-cbc: Enable crypto algorithm
- qcom,sha160-hash: Enable crypto algorithm
- qcom,sha256-hash: Enable crypto algorithm
- qcom,sha160-hmac: Enable crypto algorithm
- qcom,sha256-hmac: Enable crypto algorithm
- qcom,aes128-cbc-sha160-hmac: Enable crypto algorithm
- qcom,aes256-cbc-sha160-hmac: Enable crypto algorithm
- qcom,aes128-ctr-sha160-hmac: Enable crypto algorithm
- qcom,aes256-ctr-sha160-hmac: Enable crypto algorithm
- qcom,3des-cbc-sha160-hmac: Enable crypto algorithm
- qcom,3des-cbc-sha256-hmac: Enable crypto algorithm
- qcom,aes128-cbc-sha256-hmac: Enable crypto algorithm
- qcom,aes256-cbc-sha256-hmac: Enable crypto algorithm
- qcom,aes128-ctr-sha256-hmac: Enable crypto algorithm
- qcom,aes256-ctr-sha256-hmac: Enable crypto algorithm

* engine0: First engine for CE5 block. Some crypto HW can support multiple engine.

Required properties:
- qcom,ee: Execution engines to be used.

example:
	qcom,nss_crypto {
		compatible = "qcom,nss-crypto";
		#address-cells = <1>;
		#size-cells = <1>;
		qcom,max-contexts = <64>;
		qcom,max-context-size = <144>;
		ranges;
		ce5_node {
			compatible = "qcom,ce5";
			reg-names = "crypto_pbase", "bam_base";
			reg = <0x0073a000 0x6000>,
			    <0x00704000 0x20000>;
			qcom,dma-mask = <0x0c>;
			qcom,transform-enabled;
			qcom,aes128-cbc;
			qcom,aes256-cbc;
			qcom,aes128-ctr;
			qcom,aes256-ctr;
			qcom,aes128-ecb;
			qcom,aes256-ecb;
			qcom,3des-cbc;
			qcom,sha160-hash;
			qcom,sha256-hash;
			qcom,sha160-hmac;
			qcom,sha256-hmac;
			qcom,aes128-cbc-sha160-hmac;
			qcom,aes256-cbc-sha160-hmac;
			qcom,aes128-ctr-sha160-hmac;
			qcom,aes256-ctr-sha160-hmac;
			qcom,3des-cbc-sha160-hmac;
			qcom,3des-cbc-sha256-hmac;
			qcom,aes128-cbc-sha256-hmac;
			qcom,aes256-cbc-sha256-hmac;
			qcom,aes128-ctr-sha256-hmac;
			qcom,aes256-ctr-sha256-hmac;
			engine0 {
				qcom,ee = <2 3>;
			};
		};
	};
```

## release/src-qca-ipq53xx/linux/linux-5.4.x/Documentation/devicetree/bindings/phy/phy-qca-m31.txt
```
Qualcomm Technologies, Inc. M31 PHY
--------------------------------------

This file contains documentation for the USB M31 PHY found in Qualcomm
Technologies, Inc. IPQ5018 SoCs.

Required properties
- compatible	: must be "qca,m31-usb-hsphy"
- reg		: offset and length of the M31 PHY register set
- phy_type	: specifies type of phy "utmi"/"ulpi"
- resets	: a list of phandles and reset pairs, one for each
			entry in reset-names.
- reset-names	: Should contain "ref" for the reset

Example:
		hs_m31phy_0: hs_m31phy@5b00 {
			compatible = "qca,m31-usb-hsphy";
			reg = <0x5b000 0x3000>,
				<0x08af8800 0x400>;
			reg-names = "m31usb_phy_base",
					"qscratch_base";
			phy_type = "utmi";
			resets = <&gcc GCC_QUSB2_0_PHY_BCR>;
			reset-names = "usb2_phy_reset";

			status = "ok";
		};
```

## release/src-qca-ipq53xx/linux/linux-5.4.x/Documentation/devicetree/bindings/phy/qca-pcie-uniphy.txt
```
* PCIe UNIPHY controller

PCIe PHY nodes are defined to describe on-chip PCIe Physical layer controllers.
Each PCIe PHY controller should have its own node.

- compatible:
	Usage: required
	Value type: <stringlist>
	Definition: Value should contain "qca,uni-pcie-phy" or
			"qca,uni-pcie-phy-gen2" or "qca,uni-pcie-phy-gen3"

- phy-type:
	Usage: required
	Value type: <stringlist>
	Definition: Value should contain "gen1"/"gen2"/"gen3"

- #phy-cells:
	Usage: required
	Value type: <u32>
	Definition: Must be zero

- clocks:
	Usage: required
	Value type: <prop-encoded-array>
	Definition: A list of phandles and clock specifier pair, one
		    for each entry in clock-names property

- clock-names:
	Usage: required
	Value type: <stringlist>
	Definition: Should contain "core" for PHY core clock

- resets:
	Usage: required
	Value type: <phandle>
	Definition: List of phandle and reset specifier pairs as listed
		    in reset-names property

- reset-names:
	Usage: required
	Value type: <stringlist>
	Definition: Should contain "core" for PHY core reset

- x2:
	Usage: optional
	Value type: <u32>
	Definition: Indicates if PHY is dual lane capable

- mode-fixed:
	Usage: required
	Value type: <u32>
	Definition: Indicates the PHY operating mode. Should contain 1 for
			fixed mode and 2 for SSC mode.


* Example

	pcie_phy0: phy@86000 {
		compatible = "qca,uni-pcie-phy-gen3";
		phy-type = "gen3"
		#phy-cells = <0>;
		clocks = <&gcc GCC_PCIE0_PIPE_CLK>;
		clock-names = "pipe_clk";
		resets = <&gcc GCC_PCIE0_PHY_BCR>,
			<&gcc GCC_PCIE1PHY_PHY_BCR>;
		reset-names = "phy"
				"phy_phy";
		x2 = <1>;
		mode-fixed = <2>;
	};
```

## release/src-qca-ipq53xx/linux/linux-5.4.x/Documentation/devicetree/bindings/pinctrl/qcom,ipq5332-pinctrl.yaml
```yaml
# SPDX-License-Identifier: (GPL-2.0-only OR BSD-2-Clause)
%YAML 1.2
---
$id: http://devicetree.org/schemas/pinctrl/qcom,ipq5332-pinctrl.yaml#
$schema: http://devicetree.org/meta-schemas/core.yaml#

title: IPQ5332 TLMM block

maintainers:
  - Timple Raj M <quic_timple@quicinc.com>

description: |
  This binding describes the Top Level Mode Multiplexer block found in the
  IPQ5332 platform.

properties:
  compatible:
    const: qcom,ipq5332-pinctrl

  reg:
    maxItems: 1

  interrupts:
    description: Specifies the TLMM summary IRQ
    maxItems: 1

  interrupt-controller: true

  '#interrupt-cells':
    description:
      Specifies the PIN numbers and Flags, as defined in defined in
      include/dt-bindings/interrupt-controller/irq.h
    const: 2

  gpio-controller: true

  '#gpio-cells':
    description: Specifying the pin number and flags, as defined in
      include/dt-bindings/gpio/gpio.h
    const: 2

  gpio-ranges:
    maxItems: 1

#PIN CONFIGURATION NODES
patternProperties:
  '-pinmux$':
    type: object
    description:
      Pinctrl node's client devices use subnodes for desired pin configuration.
      Client device subnodes use below standard properties.
    $ref: "/schemas/pinctrl/pincfg-node.yaml"

    properties:
      pins:
        description:
          List of gpio pins affected by the properties specified in this
          subnode.
        items:
          oneOf:
            - pattern: "^gpio([1-9]|[1-7][0-9]|65)$"
            - enum: [ sdc1_clk, sdc1_cmd, sdc1_data, sdc2_clk, sdc2_cmd,
              sdc2_data, qdsd_cmd, qdsd_data0, qdsd_data1, qdsd_data2,
              qdsd_data3 ]
        minItems: 1
        maxItems: 4

      function:
        description:
          Specify the alternative function to be configured for the specified
          pins.

        enum: [ PTA_0, PTA_1, PTA_2, atest_char, test_char0, atest_char1,
		test_char2, atest_char3, test_tic, audio_pri, udio_pri0,
		audio_pri1, udio_sec, audio_sec0, udio_sec1, blsp0_i2c,
		lsp0_spi, blsp0_uart0, lsp0_uart1, blsp1_i2c0, lsp1_i2c1,
		blsp1_spi0, lsp1_spi1, blsp1_uart0, lsp1_uart1, blsp1_uart2,
		lsp2_i2c0, blsp2_i2c1, lsp2_spi, blsp2_spi0, lsp2_spi1,
		core_voltage, ri_trng0, cri_trng1, ri_trng2, cri_trng3,
		xc_clk, cxc_data, bg_out, gcc_plltest, cc_tlmm, gpio, ock_det,
		mac0, ac1, mdc0, dc1, mdio0, dio1, pc, cie0_clk, pcie0_wake,
		cie1_clk, pcie1_wake, cie2_clk, pcie2_wake, ll_test,
		prng_rosc0, rng_rosc1, prng_rosc2, rng_rosc3, pwm0, wm1, pwm2,
		wm3, qdss_cti_trig_in_a0, dss_cti_trig_in_a1,
		qdss_cti_trig_in_b0, dss_cti_trig_in_b1, qdss_cti_trig_out_a0,
		dss_cti_trig_out_a1, qdss_cti_trig_out_b0, dss_cti_trig_out_b1,
		qdss_traceclk_a, dss_traceclk_b, qdss_tracectl_a,
		dss_tracectl_b, qdss_tracedata_a, dss_tracedata_b, qspi_data,
		spi_clk, qspi_cs, esout, rx0, x1, sdc_data, dc_clk, sdc_cmd,
		sens_max, wci0, ci1, wci10, ci11, wci2, ci3, wci4, ci5, wci6,
		ci7, wci8, ci9, wsi_clk, si_clk3, wsi_data, si_data3,
		wsis_reset, fem0, xfem1, fem2, xfem3, fem4, xfem5, fem6,
		xfem7 ]

      drive-strength:
        enum: [2, 4, 6, 8, 10, 12, 14, 16]
        default: 2
        description:
          Selects the drive strength for the specified pins, in mA.

      bias-pull-down: true

      bias-pull-up: true

      bias-disable: true

      output-high: true

      output-low: true

    required:
      - pins
      - function

    additionalProperties: false

required:
  - compatible
  - reg
  - interrupts
  - interrupt-controller
  - '#interrupt-cells'
  - gpio-controller
  - '#gpio-cells'
  - gpio-ranges

additionalProperties: false

examples:
  - |
        #include <dt-bindings/interrupt-controller/arm-gic.h>
	tlmm: pinctrl@1000000 {
		compatible = "qcom,ipq5332-pinctrl";
		reg = <0x01000000 0x300000>;
		interrupts = <GIC_SPI 249 IRQ_TYPE_LEVEL_HIGH>;
		gpio-controller;
		#gpio-cells = <2>;
		gpio-ranges = <&tlmm 0 0 53>;
		interrupt-controller;
		#interrupt-cells = <2>;
		button_pins: button_pins {
			wps_button {
				pins = "gpio35";
				function = "gpio";
				drive-strength = <8>;
				bias-pull-up;
			};
		};
	};
```

## release/src-qca-ipq53xx/linux/linux-5.4.x/Documentation/devicetree/bindings/pinctrl/qcom,ipq9574-pinctrl.yaml
```yaml
# SPDX-License-Identifier: (GPL-2.0-only OR BSD-2-Clause)
%YAML 1.2
---
$id: http://devicetree.org/schemas/pinctrl/qcom,ipq9574-pinctrl.yaml#
$schema: http://devicetree.org/meta-schemas/core.yaml#

title: IPQ9574 TLMM block

maintainers:
  - Anusha <quic_anusha@quicinc.com>

description: |
  This binding describes the Top Level Mode Multiplexer block found in the
  IPQ9574 platform.

properties:
  compatible:
    const: qcom,ipq9574-pinctrl

  reg:
    maxItems: 1

  interrupts:
    description: Specifies the TLMM summary IRQ
    maxItems: 1

  interrupt-controller: true

  '#interrupt-cells':
    description:
      Specifies the PIN numbers and Flags, as defined in defined in
      include/dt-bindings/interrupt-controller/irq.h
    const: 2

  gpio-controller: true

  '#gpio-cells':
    description: Specifying the pin number and flags, as defined in
      include/dt-bindings/gpio/gpio.h
    const: 2

  gpio-ranges:
    maxItems: 1

#PIN CONFIGURATION NODES
patternProperties:
  '-pinmux$':
    type: object
    description:
      Pinctrl node's client devices use subnodes for desired pin configuration.
      Client device subnodes use below standard properties.
    $ref: "/schemas/pinctrl/pincfg-node.yaml"

    properties:
      pins:
        description:
          List of gpio pins affected by the properties specified in this
          subnode.
        items:
          oneOf:
            - pattern: "^gpio([1-9]|[1-7][0-9]|65)$"
            - enum: [ sdc1_clk, sdc1_cmd, sdc1_data, sdc2_clk, sdc2_cmd,
              sdc2_data, qdsd_cmd, qdsd_data0, qdsd_data1, qdsd_data2,
              qdsd_data3 ]
        minItems: 1
        maxItems: 4

      function:
        description:
          Specify the alternative function to be configured for the specified
          pins.

        enum: [ atest_char, atest_char0, atest_char1, atest_char2, atest_char3,
		audio_pdm1, audio_pri, audio_sec, blsp0_spi, blsp0_uart,
		blsp1_i2c, blsp1_spi, blsp1_uart, blsp2_i2c, blsp2_spi,
		blsp2_uart, blsp3_i2c, blsp3_spi, blsp3_uart, blsp4_i2c,
		blsp4_spi, blsp4_uart, blsp5_i2c, blsp5_uart, cri_trng0,
		cri_trng1, cri_trng3, cxc0, cxc1, dbg_out, dwc_ddrphy,
		gcc_plltest, gcc_tlmm, mac00, mac01, mac10, mac11, mdc,
		mdio, pcie0_clk, pcie0_wake, pcie1_clk, pcie1_wake, pcie2_clk
		pcie2_wake, pcie3_clk, pcie3_wake, prng_rosc0, prng_rosc1
		prng_rosc2, prng_rosc3, pta1_0, pta1_1, pta1_2, pta20, pta21,
		pwm00, pwm01, pwm02, pwm03, pwm04, pwm10, pwm11, pwm12, pwm13,
		pwm14, pwm20, pwm21, pwm22, pwm23, pwm24, pwm30, pwm31, pwm32,
		pwm33, qdss_cti_trig_in_a0, qdss_cti_trig_in_a1, qdss_cti_trig_in_b0,
		qdss_cti_trig_in_b1, qdss_cti_trig_out_a0, qdss_cti_trig_out_a1,
		qdss_cti_trig_out_b0, qdss_cti_trig_out_b1, qdss_traceclk_a,
		qdss_traceclk_b, qdss_tracectl_a, qdss_tracectl_b, qdss_tracedata_a,
		dss_tracedata_b, qdss_tracedata_b, qspi_clk, qspi_cs, qspi_data,
		rx0, rx1, sdc_clk, sdc_cmd, sdc_data, sdc_rclk, tsens_max,
		wci20, wci21, wsa_swrm, audio_pdm0 ]

      drive-strength:
        enum: [2, 4, 6, 8, 10, 12, 14, 16]
        default: 2
        description:
          Selects the drive strength for the specified pins, in mA.

      bias-pull-down: true

      bias-pull-up: true

      bias-disable: true

      output-high: true

      output-low: true

    required:
      - pins
      - function

    additionalProperties: false

required:
  - compatible
  - reg
  - interrupts
  - interrupt-controller
  - '#interrupt-cells'
  - gpio-controller
  - '#gpio-cells'
  - gpio-ranges

additionalProperties: false

examples:
  - |
        #include <dt-bindings/interrupt-controller/arm-gic.h>
        tlmm: pinctrl@1000000 {
              compatible = "qcom,ipq9574-pinctrl";
              reg = <0x01000000 0x300000>;
              interrupts = <GIC_SPI 208 IRQ_TYPE_LEVEL_HIGH>;
              interrupt-controller;
              #interrupt-cells = <2>;
              gpio-controller;
              #gpio-cells = <2>;
              gpio-ranges = <&tlmm 0 0 65>;

              serial3-pinmux {
                      pins = "gpio34", "gpio35";
                      function = "blsp2_uart";
                      drive-strength = <8>;
                      bias-pull-down;
              };
        };
```

## release/src-qca-ipq53xx/linux/linux-5.4.x/Documentation/devicetree/bindings/pwm/pwm-ipq.txt
```
QTI Pulse Width Modulation (PWM)

Required properties:
- compatible : Should contain "qti,ipq-pwm".
- clock : Should contain the input clock.
- clock-names : Should contain "core".
- pwm-base-index : The base index to be used for the pwm device.
	Should contain any unsigned integer.
- used-pwm-indices : Vector specifying the devices that are being used.
	Should contain a boolean entry for each pwm device in the chip
	specifying whether the device is being used or not.
		Example: used-pwm-indices = <1>, <1>, <0>, <1>;
	This chip has 4 pwm devices of which the third one is not used.
```
