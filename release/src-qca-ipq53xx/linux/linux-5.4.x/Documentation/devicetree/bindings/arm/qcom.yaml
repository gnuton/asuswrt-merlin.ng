## release/src-qca-ipq53xx/linux/linux-5.4.x/Documentation/devicetree/bindings/soc/qcom/qti,scm_restart_reason.txt
```
QTI_SCM_RESTART_REASON

scm restart reason driver controls the collection of crashdump.
During panic/assert the notifiers registered in this driver will be kicked in
and the magic cookie is set, the crashdumps are collected in apps bootloader.

Required properties:
 - compatible: must contain "qti,scm_restart_reason" for IPQ40xx, IPQ807x

Optional properties:
 - dload_status: indicate whether memory is reserved for crashdump.
 - dload_sec_status: indicate whether crashdump is enabled for
   secure boot.
 - dload_warm_reset: set this property to 1 to retain IMEM data
   during warm reset. dload_status also should be set to 1 when
   setting this property to 1.

Example for ipq40xx:

	qti,scm_restart_reason {
		compatible = "qti,scm_restart_reason";
		dload_status = <0>;
		dload_sec_status = <0>;
	};
```

## release/src-qca-ipq53xx/linux/linux-5.4.x/Documentation/devicetree/bindings/soc/qcom/qti,tzlog.txt
```
QTI TZLOG

This binding describes tzlog used to inspect log created by TZ. This driver
also provides capability to capture SMMU and XPU faults found by TZ.

Required properties:
 - compatible: should be "qti,tzlog"
 - interrupts: must contain interrupt used by TZ when XPU or SMMU faults are
		found
 - qti,tz-diag-buf-size: contains the TZ diag buffer size
 - qti,tz-ring-off: contains the TZ diag buffer ring offset
 - qti,tz-log-pos-info-off: contains the TZ diag buffer log position info offset

Optional properties:
 - qti,tz_kpss: should be set in case of IPQ806x platform
 - qti,hvc-enabled: defines whether TZ supports Hypervisor mode or not
 - qti,get-smmu-state: when set, will be able to get the SMMU state
 - qti,tzbsp-diag-buf-start: contains the TZ diag buffer start (as defined in
		QSEE). When specified, NS world will directly read from the
		region and dump it unlike reading the buffer via SCM interface

Example:

IPQ806x:
	qti,tzlog {
		compatible = "qti,tzlog";
		qti,tz-diag-buf-size = <0x1000>;
		qti,tz-ring-off = <7>;
		qti,tz-log-pos-info-off = <0>;
		qti,tz_kpss;
	};

IPQ40xx:
	qti,tzlog {
		compatible = "qti,tzlog";
		qti,tz-diag-buf-size = <0x1000>;
		qti,tz-ring-off = <7>;
		qti,tz-log-pos-info-off = <522>;
	};

IPQ807x:
	qti,tzlog {
		compatible = "qti,tzlog";
		interrupts = <GIC_SPI 244 IRQ_TYPE_EDGE_RISING>;
		qti,tz-diag-buf-size = <0x2000>;
		qti,tz-ring-off = <7>;
		qti,tz-log-pos-info-off = <579>;
		qti,hvc-enabled;
		qti,get-smmu-state;
	};

IPQ60xx:
	qti,tzlog {
		compatible = "qti,tzlog-ipq6018";
		interrupts = <GIC_SPI 244 IRQ_TYPE_EDGE_RISING>;
		qti,tzbsp-diag-buf-start = <0x4a7df000>;
		qti,tz-diag-buf-size = <0x3000>;
		qti,tz-ring-off = <7>;
		qti,tz-log-pos-info-off = <810>;
		qti,hvc-enabled;
		qti,get-smmu-state;
	};

IPQ9574:
	qti,tzlog {
		compatible = "qti,tzlog-ipq9574";
		interrupts = <GIC_SPI 244 IRQ_TYPE_EDGE_RISING>;
		qti,tzbsp-diag-buf-start = <0x4a7df000>;
		qti,tz-diag-buf-size = <0x3000>;
		qti,tz-ring-off = <7>;
		qti,tz-log-pos-info-off = <810>;
		qti,hvc-enabled;
		qti,get-smmu-state;
	};
```

## release/src-qca-ipq53xx/linux/linux-5.4.x/Documentation/devicetree/bindings/soc/qcom/rpm-log.txt
```
* RPM Log

RPM maintains Ulog in the RPM RAM. A device tree node is added
that will hold the address of the RPM RAM region from where
Ulog is read. The physical address from the RPM RAM region
contains a header where various parameters to read the log are
defined. These parameter's offsets in the header are also stored
as a part of the device tree node.

The required properties for rpm-log are:

- compatible: "qti,rpm-log"
- reg: Specifies the base physical address and the size of the RPM
	registers from where ulog is read.
	Second register(optional) specifies the offset of the rpm
	log start address pointer. If the second register is available,
	the offset value read is added to the first register address
	to read the ulog message.
- qti,rpm-addr-phys: RPM reads physical address of the RPM RAM region
		differently when compared to Apps. Physical address of
		the RPM RAM region is at an offset when seen from Apps.
		This property specifies the offset which will get added
		to the physical address of RPM RAM to make it
		accessible to the Apps.
- qti,offset-version: Offset from the start of the phys_addr_base where version
			information is stored.
- qti,offset-page-buffer-addr: Offset from the start of the phys_addr_base
				where raw log start address is stored. Raw log
				start address is the start of raw log in the
				RPM address space as it should be seen from rpm.
- qti,offset-log-len: Offset from the start of the phy_addr_base where log
			length is stored.
- qti,offset-log-len-mask: Offset from the start of the phy_addr_base where
				log length mask is stored.
- qti,offset-page-indices: Offset from the start of the phy_addr_base where
				index to the writer is stored.
- qti,reg-offsets: Offset index to the writer.
- qti,rpm-log-len: Log buffer length.

Example 1:
qti,rpm-log@10c0c8 {
	compatible = "qti,rpm-log";
	reg = <0x0010c0c8 0x00002000>;
	qti,offset-version = <4>;
	qti,reg-offsets = <0x00000080 0x000000A0>;
	qti,rpm-log-len = <0x1800>;
};

Example 2:
qti,rpm-log@fc000000 {
	compatible = "qti,rpm-log";
	reg = <0xfc000000 0x2000>,
		<0xfc190018 0x4>;
	qti,offset-rpm-addr = <0xfc000000>;
	qti,offset-version = <4>;
	qti,offset-page-buffer-addr = <36>;
	qti,offset-log-len = <40>;
	qti,offset-log-len-mask = <44>;
	qti,offset-page-indices = <56>;
};
```

## release/src-qca-ipq53xx/linux/linux-5.4.x/arch/arm/mach-qcom/Kconfig
```kconfig
# SPDX-License-Identifier: GPL-2.0-only
menuconfig ARCH_QCOM
	bool "Qualcomm Support"
	depends on ARCH_MULTI_V7
	select ARCH_SUPPORTS_BIG_ENDIAN
	select ARM_GIC
	select ARM_AMBA if !IPQ_FLASH_16M_PROFILE
	select PINCTRL
	select QCOM_SCM if SMP
	select ARM_GIC_V2M
	select GENERIC_MSI_IRQ_DOMAIN
	help
	  Support for Qualcomm's devicetree based systems.

if ARCH_QCOM

config ARCH_IPQ5332
	bool "Enable support for IPQ5332"
	help
	  This enables support for the IPQ5332 chipset. If you dont
	  know what do here, say N

config ARCH_IPQ6018
	bool "Enable support for IPQ6018"
	help
	  This enables support for the IPQ6018 chipset. If you dont
	  know what do here, say N

config ARCH_IPQ9574
	bool "Enable support for IPQ9574"
	help
	  This enables support for the IPQ9574 chipset. If you dont
	  know what do here, say N

config ARCH_MSM8X60
	bool "Enable support for MSM8X60"
	select CLKSRC_QCOM

config ARCH_MSM8960
	bool "Enable support for MSM8960"
	select CLKSRC_QCOM

config ARCH_MSM8974
	bool "Enable support for MSM8974"
	select HAVE_ARM_ARCH_TIMER

config ARCH_MDM9615
	bool "Enable support for MDM9615"
	select CLKSRC_QCOM

config IPQ_MEM_PROFILE
	int "Select Memory Profile"
	range 0 1024
	default 0
	---help---
	This option select memory profile to be used, which defines
	the reserved memory configuration used in device tree.

	If unsure, say 0

config SKB_FIXED_SIZE_2K
	bool "SKB size fixed at 2K"
	default n
	help
		This is a hint to the NSS driver that the ‘skbuff’ size might
		need to be fixed at 2KB, to conserve memory.

config ARCH_IPQ256M
	bool "Enable 256M config"
	default n
	help
	  This sets the text offset of 256M profile, which makes kernel aware of
          first 16MB of DDR.

config IPQ_FLASH_16M_PROFILE
	bool "Enable 16M Flash Profile"
	---help---
	This option select flash profile to be used.

	If unsure, say N.

endif
```

## release/src-qca-ipq53xx/linux/linux-5.4.x/drivers/base/regmap/Kconfig
```kconfig
# SPDX-License-Identifier: GPL-2.0
# Generic register map support.  There are no user servicable options here,
# this is an API intended to be used by other kernel subsystems.  These
# subsystems should select the appropriate symbols.

config REGMAP
	select IRQ_DOMAIN if REGMAP_IRQ
	tristate

config REGCACHE_COMPRESSED
	select LZO_COMPRESS
	select LZO_DECOMPRESS
	bool

config REGMAP_AC97
	tristate

config REGMAP_I2C
	tristate
	select REGMAP
	depends on I2C

config REGMAP_SLIMBUS
	tristate
	select REGMAP
	depends on SLIMBUS

config REGMAP_SPI
	tristate
	select REGMAP
	depends on SPI_MASTER
	depends on SPI

config REGMAP_SPMI
	tristate
	select REGMAP
	depends on SPMI

config REGMAP_W1
	tristate
	select REGMAP
	depends on W1

config REGMAP_MMIO
	tristate
	select REGMAP

config REGMAP_IRQ
	bool
	select REGMAP

config REGMAP_SOUNDWIRE
	tristate
	select REGMAP
	depends on SOUNDWIRE

config REGMAP_SCCB
	tristate
	select REGMAP
	depends on I2C

config REGMAP_I3C
	tristate
	select REGMAP
	depends on I3C

config REGMAP_ALLOW_WRITE_DEBUGFS
	depends on REGMAP && DEBUG_FS
	bool "Allow REGMAP debugfs write"
```

## release/src-qca-ipq53xx/linux/linux-5.4.x/drivers/bus/mhi/clients/Kconfig
```kconfig
# SPDX-License-Identifier: GPL-2.0-only

menu "MHI clients support"
	depends on MHI_BUS

config MHI_UCI
	tristate "MHI UCI"
	depends on MHI_BUS
	help
	  MHI based userspace client interface driver is for transferring
	  data between host and device using standard file operations from
	  user space. Open, read, write, and close operations are supported
	  by this driver. Please check mhi_uci_match_table for all supported
	  channels that are exposed to userspace.

config MHI_NETDEV
	tristate "MHI NETDEV"
	depends on MHI_BUS
	help
	  MHI based net device driver for transferring IP traffic
	  between host and modem. By enabling this driver, clients
	  can transfer data using standard network interface. Over
	  the air traffic goes thru mhi netdev interface.

endmenu
```

## release/src-qca-ipq53xx/linux/linux-5.4.x/drivers/mtd/composite/Kconfig
```kconfig
menu "Composite MTD device drivers"
	depends on MTD!=n

config MTD_VIRT_CONCAT
	tristate "Virtual concat MTD device"
	help
	  This driver allows creation of a virtual MTD concat device, which
	  concatenates multiple underlying MTD devices to a single device.
	  This is required by some SoC boards where multiple memory banks are
	  used as one device with partitions spanning across device boundaries.

endmenu
```

## release/src-qca-ipq53xx/linux/linux-5.4.x/drivers/nvram/Kconfig
```kconfig
menu "ASUS NVRAM"

config	ASUS_NVRAM_API
	tristate "ASUS NVRAM R/W API"
	default m
	---help---
	ASUS NVRAM R/W API

config NVRAM_64K
	bool "Support nvram 64K. In fact, only 60KB for Ralink platfrom and the first 4KB is used by uboot."
	depends on ASUS_NVRAM_API
	default n

endmenu
```

## release/src-qca-ipq53xx/linux/linux-5.4.x/drivers/platform/Kconfig
```kconfig
# SPDX-License-Identifier: GPL-2.0-only
if X86
source "drivers/platform/x86/Kconfig"
endif
if MIPS
source "drivers/platform/mips/Kconfig"
endif

source "drivers/platform/goldfish/Kconfig"

source "drivers/platform/chrome/Kconfig"

source "drivers/platform/mellanox/Kconfig"

source "drivers/platform/olpc/Kconfig"

source "drivers/platform/mikrotik/Kconfig"

if ARCH_QCOM
source "drivers/platform/ipq/Kconfig"

source "drivers/platform/msm/Kconfig"
endif
```

## release/src-qca-ipq53xx/linux/linux-5.4.x/drivers/platform/ipq/Kconfig
```kconfig
menu "IPQ specific device drivers"
	depends on ARCH_QCOM

config BOOTCONFIG_PARTITION
	tristate "BOOTCONFIG Partition support"
	help
	  Say Y here if you would like to use hard disks under Linux which
	  were partitioned using MTD/EFI.

config NUM_ALT_PARTITION
	int "Number of partitions used for failsafe boot during sysupgrade"
	default 8
	range 0 16
	help
	  This value defines the number of partitions used in bootconfig that
	  is required for failsafe boot during sysupgrade.

	  Leave the default value if unsure.

endmenu
```
