## release/src-qca-ipq53xx/linux/linux-5.4.x/Documentation/devicetree/bindings/arm/qcom.yaml
```yaml
# SPDX-License-Identifier: GPL-2.0
%YAML 1.2
---
$id: http://devicetree.org/schemas/bindings/arm/qcom.yaml#
$schema: http://devicetree.org/meta-schemas/core.yaml#

title: QCOM device tree bindings

maintainers:
  - Stephen Boyd <sboyd@codeaurora.org>

description: |
  Some qcom based bootloaders identify the dtb blob based on a set of
  device properties like SoC and platform and revisions of those components.
  To support this scheme, we encode this information into the board compatible
  string.

  Each board must specify a top-level board compatible string with the following
  format:

  	compatible = "qcom,<SoC>[-<soc_version>][-<foundry_id>]-<board>[/<subtype>][-<board_version>]"

  The 'SoC' and 'board' elements are required. All other elements are optional.

  The 'SoC' element must be one of the following strings:

  	apq8016
  	apq8074
  	apq8084
  	apq8096
  	msm8916
  	msm8974
  	msm8992
  	msm8994
  	msm8996
  	mdm9615
	ipq5018
	ipq6018
  	ipq8074
  	sdm845

  The 'board' element must be one of the following strings:

  	cdp
  	liquid
  	dragonboard
  	mtp
  	sbc
  	hk01
  	qrd
	mp03

  The 'soc_version' and 'board_version' elements take the form of v<Major>.<Minor>
  where the minor number may be omitted when it's zero, i.e.  v1.0 is the same
  as v1. If all versions of the 'board_version' elements match, then a
  wildcard '*' should be used, e.g. 'v*'.

  The 'foundry_id' and 'subtype' elements are one or more digits from 0 to 9.

  Examples:

  	"qcom,msm8916-v1-cdp-pm8916-v2.1"

  A CDP board with an msm8916 SoC, version 1 paired with a pm8916 PMIC of version
  2.1.

  	"qcom,apq8074-v2.0-2-dragonboard/1-v0.1"

  A dragonboard board v0.1 of subtype 1 with an apq8074 SoC version 2, made in
  foundry 2.

properties:
  compatible:
    oneOf:
      - items:
          - enum:
              - qcom,apq8016-sbc
          - const: qcom,apq8016

      - items:
          - enum:
              - qcom,apq8064-cm-qs600
              - qcom,apq8064-ifc6410
          - const: qcom,apq8064

      - items:
          - enum:
              - qcom,apq8074-dragonboard
          - const: qcom,apq8074

      - items:
          - enum:
              - qcom,apq8060-dragonboard
              - qcom,msm8660-surf
          - const: qcom,msm8660

      - items:
          - enum:
              - qcom,apq8084-mtp
              - qcom,apq8084-sbc
          - const: qcom,apq8084

      - items:
          - enum:
              - qcom,msm8960-cdp
          - const: qcom,msm8960

      - items:
          - enum:
              - fairphone,fp2
              - lge,hammerhead
              - sony,xperia-amami
              - sony,xperia-castor
              - sony,xperia-honami
          - const: qcom,msm8974

      - items:
          - const: qcom,msm8916-mtp
          - const: qcom,msm8916-mtp/1
          - const: qcom,msm8916

      - items:
          - enum:
              - longcheer,l8150
              - samsung,a3u-eur
              - samsung,a5u-eur
          - const: qcom,msm8916

      - items:
          - const: qcom,msm8996-mtp

      - items:
          - enum:
              - qcom,ipq4019-ap-dk04.1-c3
              - qcom,ipq4019-ap-dk07.1-c1
              - qcom,ipq4019-ap-dk07.1-c2
              - qcom,ipq4019-dk04.1-c1
          - const: qcom,ipq4019

      - items:
          - enum:
              - qcom,ipq5018-ap-mp03.1
              - qcom,ipq5018-ap-mp03.1-c2
              - qcom,ipq5018-ap-mp03.1-c3
              - qcom,ipq5018-ap-mp03.3
              - qcom,ipq5018-ap-mp03.3-c2
          - const: qcom,ipq5018

      - items:
          - enum:
              - qcom,ipq8064-ap148
          - const: qcom,ipq8064

      - items:
          - enum:
              - qcom,ipq8074-ap-hk01-c1
              - qcom,ipq8074-ap-hk01-c2
              - qcom,ipq8074-ap-hk01-c3
              - qcom,ipq8074-ap-hk01-c4
              - qcom,ipq8074-ap-hk01-c5
              - qcom,ipq8074-ap-hk02
              - qcom,ipq8074-ap-hk06
              - qcom,ipq8074-ap-hk07
              - qcom,ipq8074-ap-hk08
              - qcom,ipq8074-ap-hk09
              - qcom,ipq8074-ap-hk10-c1
              - qcom,ipq8074-ap-hk10-c2
              - qcom,ipq8074-ap-hk11
              - qcom,ipq8074-ap-hk14
              - qcom,ipq8074-ap-oak02
              - qcom,ipq8074-ap-oak03
              - qcom,ipq8074-ap-ac01
              - qcom,ipq8074-ap-ac02
              - qcom,ipq8074-ap-ac03
              - qcom,ipq8074-ap-ac04
          - const: qcom,ipq8074

      - items:
          - enum:
              - qcom,ipq6018-ap-cp01-c1
              - qcom,ipq6018-ap-cp02-c1
          - const: qcom,ipq6018

...
```

## release/src-qca-ipq53xx/linux/linux-5.4.x/Documentation/devicetree/bindings/display/qti,qpic-fb.txt
```
* QPIC LCD node

Required properties:
- compatible:		"qti,mdss_qpic"
- reg:			QPIC LCD register address range
- clocks:		must contain core clock and always on clock
- clock-names:		must contain "core" for the core clock and "aon" for the
			always on clock
- dmas:			DMA specifier, consisting of a phandle BAM DMA
			controller node and the channel number to
			be used for LCD. Refer to dma.txt and
			qcom_bam_dma.txt for more details
Optional properties:
- qti,bam_timeout:	Timeout in ms for QPIC BAM transfer. Default timeout
			i.e. 400 ms will be used if this parameter is not
			present.

Example:

qti_mdss_qpic@7980000 {
	compatible = "qti,mdss_qpic";
	reg = <0x7980000 0x24000>;
	interrupts = <0 106 0>;
	clocks = <&gcc GCC_QPIC_CLK>, <&gcc GCC_QPIC_AHB_CLK>;
	clock-names = "core", "aon";
	dmas = <&qpic_bam 6>;
	qti,bam_timeout = <1000>;
};

* QPIC LCD Display Panel

Required properties:
- compatible:		"qti,mdss-qpic-panel"
- label:		QPIC LCD Panel Name
- qti,mdss-pan-res:	QPIC LCD Display Panel resolution in x,y
- qti,mdss-pan-bpp:	QPIC LCD Display Panel bits per pixel
- qti,refresh_rate:	QPIC LCD Display Panel refresh rate

Example:

qti_mdss_qpic_panel {
	compatible = "qti,mdss-qpic-panel";
	label = "qpic lcd panel";
	qti,mdss-pan-res = <800 480>;
	qti,mdss-pan-bpp = <18>;
	qti,refresh_rate = <60>;
	status = "disabled";
};
```

## release/src-qca-ipq53xx/linux/linux-5.4.x/Documentation/devicetree/bindings/leds/leds-ipq.txt
```
QTI LED Controller Driver.

Required properties:
- compatible: "qti,ledc"
- reg: Base address for LED registers.
- reg-names: Register name for reference.
- qti,tcsr_ledc_values: The values with which the 12 LED Control registers needs to be initialized with.
- qti,ledc_blink_indices_cnt: No.of blink registers configured. Allowed value is 0 to 4.
- qti,ledc_blink_indices: Indices of LEDs which are configured as blink LEDs. No. of entries
                        should correspond to the value in qti,ledc_blink_indices_cnt.

Optional properties:
- qti,ledc_blink_idx_src_pair: List of LED index + blink source pairs.

Examples:

qti: ledc@1937000 {
	compatible = "qti,ledc";
	reg = <0x1937000 0x20070>;
	reg-names = "ledc_base_addr";
	qti,tcsr_ledc_values = <0x320195 0xA418820 0x16A4A0E6 0x2307B9AC 0x16AD272 \
		0xFFFFFFFF 0x0 0x0 0x7D006F 0x0 0x10482090 0x3FFFFE4>;
	qti,ledc_blink_indices_cnt = <4>;
	qti,ledc_blink_indices = <19 20 21 22>;
	qti,ledc_blink_idx_src_pair = <3 20>, <4 21>, <5 22>;
};
```

## release/src-qca-ipq53xx/linux/linux-5.4.x/Documentation/devicetree/bindings/misc/qseecom.txt
```
QSEECOM DRIVER
--------------

This driver acts as an interface for communication between the secure and non-
secure world which allows us to load and run applications securely.

Required properties:
  - compatible = "ipq807x-qseecom"; for IPQ807x device
		= "ipq8064-qseecom"; for IPQ8064 device
		= "ipq40xx-qseecom"; for IPQ40xx device
		= "ipq6018-qseecom"; for IPQ6018 device
  - mem-start: Address in reserved memory region to load the application
  - mem-size: Size available for the application

Note:
mem-start and mem-size entries should not be given for ipq8064 device as it is
taken from the elf data.

Example:

qseecom {
	compatible = "ipq807x-qseecom";
	mem-start = <0x4a400000>;
	mem-size = <0x200000>;
};
```

## release/src-qca-ipq53xx/linux/linux-5.4.x/Documentation/devicetree/bindings/misc/srd.txt
```
Silent Reboot Debug

Required properties:

- compatible : srd

Example:

srd_trace: srd_trace {
	compatible = "srd";
};
```

## release/src-qca-ipq53xx/linux/linux-5.4.x/Documentation/devicetree/bindings/mtd/mtd-concat.txt
```
Virtual MTD concat device

Requires properties:
- devices: list of phandles to mtd nodes that should be concatenated

Example:

&spi {
	flash0: flash@0 {
		...
	};
	flash1: flash@1 {
		...
	};
};

flash {
	compatible = "mtd-concat";

	devices = <&flash0 &flash1>;

	partitions {
		compatible = "fixed-partitions";

		partition@0 {
			label = "boot";
			reg = <0x0000000 0x0040000>;
			read-only;
		};

		partition@40000 {
			label = "firmware";
			reg = <0x0040000 0x1fc0000>;
		};
	}
}
```

## release/src-qca-ipq53xx/linux/linux-5.4.x/Documentation/devicetree/bindings/net/qcom-eip-crypto.txt
```
* Qualcomm Technologies Inc. EIP CRYPTO Driver.

The driver is responsible for registering crypto algorithms to linux.
Its responsible for punting the crypto requests to respective EIP DMA driver.

Required properties:
- compatible: "qcom,eip_crypto"
- status: "ok"

example:
	eip_crypto: eip_crypto {
			    compatible = "qcom,eip_crypto";
			    status = "ok"
		    };
```

## release/src-qca-ipq53xx/linux/linux-5.4.x/Documentation/devicetree/bindings/net/qcom-eip196-driver.txt
```
* Qualcomm Technologies Inc. EIP196 DMA Driver.

The driver is responsible for interacting with EIP196 hardware. It converts
the requests from crypto driver to hardware understandable objects.
Its responsible for handling the interrupts generated by EIP196 hardware.

Required properties:
- compatible = "qcom,eip";
- reg-names = "eip_pbase";
- reg = <0x39800000 0x7ffff>;
- reg_offset = <0x80000>;
- ranges;
- clocks = <&nsscc NSS_CC_EIP_CLK>,
	<&nsscc NSS_CC_NSSNOC_EIP_CLK>;
- clock-names = "eip_clk", "eip_nocclk";
- clock-frequency = /bits/ 64 <300000000 300000000>;
- status = "ok";

- interrupts = <GIC_SPI 107 IRQ_TYPE_LEVEL_HIGH>,
	   <GIC_SPI 108 IRQ_TYPE_LEVEL_HIGH>,
	   <GIC_SPI 109 IRQ_TYPE_LEVEL_HIGH>,
	   <GIC_SPI 110 IRQ_TYPE_LEVEL_HIGH>;

example:
	eip: eip196@39800000 {
		compatible = "qcom,eip";
		reg-names = "eip_pbase";
		reg = <0x39800000 0x7ffff>;
		reg_offset = <0x80000>;
		ranges;
		clocks = <&nsscc NSS_CC_EIP_CLK>,
		       <&nsscc NSS_CC_NSSNOC_EIP_CLK>;
		clock-names = "eip_clk", "eip_nocclk";
		clock-frequency = /bits/ 64 <300000000 300000000>;
		status = "ok";
		interrupts = <GIC_SPI 107 IRQ_TYPE_LEVEL_HIGH>,
			   <GIC_SPI 108 IRQ_TYPE_LEVEL_HIGH>,
			   <GIC_SPI 109 IRQ_TYPE_LEVEL_HIGH>,
			   <GIC_SPI 110 IRQ_TYPE_LEVEL_HIGH>;

		dma0 {
		     tx_cpu = /bits/ 8 <0>;
		     rx_cpu = /bits/ 8 <0>;
		     ring-name = "lookaside";
		     ring-id = /bits/ 8 <0>;
		};

		dma1 {
		     tx_cpu = /bits/ 8 <1>;
		     rx_cpu = /bits/ 8 <1>;
		     ring-name = "lookaside";
		     ring-id = /bits/ 8 <1>;
		};

		dma2 {
		     tx_cpu = /bits/ 8 <2>;
		     rx_cpu = /bits/ 8 <2>;
		     ring-name = "lookaside";
		     ring-id = /bits/ 8 <2>;
		};

		dma3 {
		     tx_cpu = /bits/ 8 <3>;
		     rx_cpu = /bits/ 8 <3>;
		     ring-name = "lookaside";
		     ring-id = /bits/ 8 <3>;
		};
	};
```

## release/src-qca-ipq53xx/linux/linux-5.4.x/Documentation/devicetree/bindings/net/qcom-eip197-driver.txt
```
* Qualcomm Technologies Inc. EIP197 DMA Driver.

The driver is responsible for interacting with EIP197 hardware. It converts
the requests from crypto driver to hardware understandable objects.
Its responsible for handling the interrupts generated by EIP197 hardware.

Required properties:
- compatible = "qcom,eip";
- reg-names = "eip_pbase";
- reg = <0x39800000 0x7ffff>;
- reg_offset = <0x80000>;
- ranges;
- clocks = <&nsscc NSS_CC_CRYPTO_CLK>,
	<&nsscc NSS_CC_NSSNOC_CRYPTO_CLK>,
	<&nsscc NSS_CC_CRYPTO_PPE_CLK>;
- clock-names = "crypto_clk", "crypto_nocclk",
		"crypto_ppeclk";
- clock-frequency = /bits/ 64 <600000000 600000000 300000000>;
- qcom,inline-enabled;
- status = "ok";
- interrupts = <GIC_SPI 385 IRQ_TYPE_LEVEL_HIGH>,
	<GIC_SPI 386 IRQ_TYPE_LEVEL_HIGH>,
	<GIC_SPI 387 IRQ_TYPE_LEVEL_HIGH>,
	<GIC_SPI 388 IRQ_TYPE_LEVEL_HIGH>;

example:
	eip: eip197@39800000 {
		compatible = "qcom,eip";
		reg-names = "eip_pbase";
		reg = <0x39800000 0x7ffff>;
		reg_offset = <0x80000>;
		ranges;
		clocks = <&nsscc NSS_CC_CRYPTO_CLK>,
		    <&nsscc NSS_CC_NSSNOC_CRYPTO_CLK>,
		    <&nsscc NSS_CC_CRYPTO_PPE_CLK>;
		clock-names = "crypto_clk", "crypto_nocclk",
		     "crypto_ppeclk";
		clock-frequency = /bits/ 64 <600000000 600000000 300000000>;
		qcom,inline-enabled;
		status = "ok";
		interrupts = <GIC_SPI 385 IRQ_TYPE_LEVEL_HIGH>,
			<GIC_SPI 386 IRQ_TYPE_LEVEL_HIGH>,
			<GIC_SPI 387 IRQ_TYPE_LEVEL_HIGH>,
			<GIC_SPI 388 IRQ_TYPE_LEVEL_HIGH>;

		dma0 {
		     tx_cpu = /bits/ 8 <0>;
		     rx_cpu = /bits/ 8 <0>;
		     ring-name = "lookaside";
		     ring-id = /bits/ 8 <0>;
		};

		dma1 {
		     tx_cpu = /bits/ 8 <1>;
		     rx_cpu = /bits/ 8 <1>;
		     ring-name = "lookaside";
		     ring-id = /bits/ 8 <1>;
		};

		dma2 {
		     tx_cpu = /bits/ 8 <2>;
		     rx_cpu = /bits/ 8 <2>;
		     ring-name = "lookaside";
		     ring-id = /bits/ 8 <2>;
		};

		dma3 {
		     tx_cpu = /bits/ 8 <3>;
		     rx_cpu = /bits/ 8 <3>;
		     ring-name = "lookaside";
		     ring-id = /bits/ 8 <3>;
		};
	};
```
